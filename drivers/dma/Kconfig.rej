## drivers/dma/Kconfig.rej
```kconfig
@@ -733,6 +733,13 @@
 	  driver provides the dmaengine required by the DisplayPort subsystem
 	  display driver.
 
+config ARM_DMA350
+	tristate "ARM DMA350 support"
+	select DMA_ENGINE
+	select DMA_VIRTUAL_CHANNELS
+	help
+	  Enable support for ARM  DMA350 controller.
+
 # driver files
 source "drivers/dma/amd/Kconfig"
 
```
